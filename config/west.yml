## config/west.yml
```yaml
manifest:
  remotes:
    - name: zmkfirmware
      url-base: https://github.com/zmkfirmware
    - name: ReFil
      url-base: https://github.com/ReFil
  projects:
    - name: zmk
      remote: ReFil
      revision: rgb-momentary-eff
      import: app/west.yml
  self:
    path: config
```
